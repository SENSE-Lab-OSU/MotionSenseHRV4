## spi_flash/src/drivers/Kconfig
```kconfig
# Copyright (c) 2022 Nordic Semiconductor ASA
# SPDX-License-Identifier: Apache-2.0

menuconfig DISK_DRIVER_RAW_NAND
    bool
    prompt "NAND Disk for file storage."
    default n

menuconfig DISK_DRIVER_CUSTOM_NOR
    bool
    prompt "Custom Qspi NAND driver, modified from qspi_nor.c to be more generic and customizable."
    default n

menuconfig RAW_NAND_ALLOW_ERASE_PAGE_REWRITE
    bool
    prompt "Allows a page write to an already written page to be rewritten by eraseing at the block level, followed by restoration of all existing pages."
    default n
```

## CMakeLists.txt
```
# SPDX-License-Identifier: Apache-2.0

cmake_minimum_required(VERSION 3.20.0)
find_package(Zephyr REQUIRED HINTS $ENV{ZEPHYR_BASE})
project(mass)

if((NOT CONFIG_DISK_DRIVER_FLASH) AND
   (NOT CONFIG_DISK_DRIVER_RAM) AND
   (NOT CONFIG_DISK_DRIVER_SDMMC))
	message( FATAL_ERROR "No disk access settings detected." )
endif()

FILE(GLOB_RECURSE app_sources src/*.c)
target_sources(app PRIVATE ${app_sources})

if(CONFIG_BUILD_WITH_TFM)
  target_include_directories(app PRIVATE
    $<TARGET_PROPERTY:tfm,TFM_BINARY_DIR>/install/interface/include
  )
endif()
```

## prj.conf
```kconfig
CONFIG_STDOUT_CONSOLE=y
CONFIG_NEWLIB_LIBC=y
CONFIG_LOG=y
#USB related configs
CONFIG_USB_DEVICE_STACK=y
CONFIG_USB_DEVICE_PRODUCT="Zephyr MSC sample"
CONFIG_USB_DEVICE_PID=0x0008

CONFIG_TEST_RANDOM_GENERATOR=y
CONFIG_TIMER_RANDOM_GENERATOR=y
CONFIG_USB_DRIVER_LOG_LEVEL_ERR=y
CONFIG_USB_MASS_STORAGE=y

CONFIG_DISK_DRIVER_FLASH=y
CONFIG_FILE_SYSTEM=y
#CONFIG_FILE_SYSTEM_LITTLEFS=y
#CONFIG_FAT_FILESYSTEM_ELM=y


CONFIG_FLASH_MAP=y
CONFIG_FLASH_PAGE_LAYOUT=y
CONFIG_NORDIC_QSPI_NOR_FLASH_LAYOUT_PAGE_SIZE=4096
 
CONFIG_USB_DEVICE_LOG_LEVEL_ERR=y
CONFIG_USB_MASS_STORAGE_LOG_LEVEL_ERR=y
CONFIG_USB_DEVICE_INITIALIZE_AT_BOOT=n

CONFIG_MAIN_STACK_SIZE=50192
```

## src/main.c
```c
/*
 * Copyright (c) 2016 Intel Corporation.
 * Copyright (c) 2019-2020 Nordic Semiconductor ASA
 *
 * SPDX-License-Identifier: Apache-2.0
 */
#include <zephyr/kernel.h>
#include <zephyr/logging/log.h>
#include <zephyr/usb/usb_device.h>
#include <stdio.h>
#include <zephyr/random/rand32.h>
#include "filesystem/zephyrfilesystem.h"


int a = -890;

#define RAND_MAX 64
LOG_MODULE_REGISTER(main);

int64_t start_time;



void start_timer(){
	start_time = k_uptime_get();
}


int64_t stop_timer(){
	int64_t length = k_uptime_get() - start_time;
	start_time = 0;
	return length;
}



void main(void)
{
	
	setup_disk();
	printk("disk setup complete!\n");
	int test_data[50000] = {1, 2, 4, 5, 6, };
	int ret;
	for (int counter = 0; counter < sizeof(test_data)/sizeof(int); counter++){
		test_data[counter] = sys_rand32_get() % 10000;
	}
	k_sleep(K_SECONDS(2));
	//create_test_files();
	write_to_file(test_data, sizeof(test_data));
	int k = 0;
	start_timer();
	for (int x = 0; x < 1; x++){
		write_to_file(test_data, sizeof(test_data));
		//submit_write(test_data, sizeof(test_data));
	}

	
	uint64_t total_time = stop_timer();
	printk("time: %llu \n", total_time);
	close_all_files();
	ret = usb_enable(NULL);
	
	if (ret != 0) {
		LOG_ERR("Failed to enable USB");
		return;
	}
	printk("%i \n", k);
	LOG_INF("Main Mass Application\n");
	LOG_INF("The device is put in USB mass storage mode.\n");
}
```
